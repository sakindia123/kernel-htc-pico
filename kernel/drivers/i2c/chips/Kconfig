## kernel/drivers/i2c/chips/Kconfig
```kconfig
#
# Miscellaneous I2C chip drivers configuration
#
# *** DEPRECATED! Do not add new entries! See Makefile ***
#

menu "Miscellaneous I2C Chip support"

config SENSORS_ONLY_BMA250
	tristate "BMA250 acceleration sensor support"
	depends on I2C=y
	help
	  BMA250 ONLY G-sensor Driver implemented by HTC.

config TPS65200
        tristate "tps65200 Driver"
        depends on I2C
        help
         TPS65200 Switch charger implemented by HTC.
         This could enable battery driver to set
         Charging current 100mA~500mA or 500mA~1000mA
         by GPIO or Register

config INPUT_CAPELLA_CM3628
	tristate "CM3628 proximity and light sensor"
	help
	  Say Y here to enable the CM3628 Short Distance Proximity
	  Sensor with Ambient Light Sensor.

config INPUT_CAPELLA_CM3629
	tristate "CM3629 proximity and light sensor"
	help
	  Say Y here to enable the CM3629 Short Distance Proximity
	  Sensor with Ambient Light Sensor.

endmenu
```
